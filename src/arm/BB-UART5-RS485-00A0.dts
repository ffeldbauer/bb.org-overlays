/*
 * Copyright (C) 2015 Florian Feldbauer <feldbaue@kph.uni-mainz.de>
 *
 * RS485 with auto direction on UART5
 * HDMI cape has to be disapled in order to use UART5!
 *
 * This program is free software; you can redistribute it and/or modify
 * it under the terms of the GNU General Public License as published by
 * the Free Software Foundation; either version 3 of the License, or
 * (at your option) any later version.
 */

/dts-v1/;
/plugin/;

#include <dt-bindings/board/am335x-bbw-bbb-base.h>
#include <dt-bindings/pinctrl/am33xx.h>

/{
  compatible = "ti,beaglebone", "ti,beaglebone-black";

  /*identification*/
  part-number = "BB-RS485";
  version = "00A0";

  /* state the resources this cape uses */
  exclusive-use =
    /* the pin header uses */
    "P8.37",	/* uart5_txd */
    "P8.38",	/* uart5_rxd */
    "P8.32",  /* uart5_rtsn */
		/* the hardware ip uses */
    "gpio0_11",
		"uart5";

  fragment@0 {
    target = <&am33xx_pinmux>;
    __overlay__ {
      bb_uart5_rs485_pins: pinmux_bb_uart5_rs485_pinux {
        pinctrl-single,pins = <
          BONE_P8_38 ( PIN_INPUT           | MUX_MODE4 )
          BONE_P8_37 ( PIN_OUTPUT          | MUX_MODE4 )
          BONE_P8_32 ( PIN_OUTPUT_PULLDOWN | MUX_MODE7 )
        >;
      };
    };
  };

  fragment@1 {
    target = <&uart5>;
    __overlay__ {
      status = "okay";
      pinctrl-names = "default";
      pinctrl-0 = <&bb_uart5_rs485_pins>;

      rs485-rts-delay = <0 0>;
      rts-gpio = <&gpio0 11 1>; /* GPIO_ACTIVE_HIGH>; */
      rs485-rts-active-high;
      linux,rs485-enabled-at-boot-time;
    };
  };
};

